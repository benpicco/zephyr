## drivers/ieee802154/Kconfig.at86rf233
```kconfig
# Kconfig.at86rf233 - Atmel AT86RF233 configuration options
#
#
# Copyright (c) 2019 ML!PA Consulting GmbH
#
# SPDX-License-Identifier: Apache-2.0
#

menuconfig  IEEE802154_AT86RF233
	bool "Atmel AT86RF233 Driver support"
	depends on NETWORKING && SPI

if IEEE802154_AT86RF233

config IEEE802154_AT86RF233_DRV_NAME
	string "Atmel AT86RF233 Driver's name"
	default "AT86RF233"
	help
	  This option sets the driver name. Do not change it unless
	  you know what you are doing.

config IEEE802154_AT86RF233_INIT_PRIO
	int "AT86RF233 initialization priority"
	default 80
	help
	  Set the initialization priority number. Do not change it unless
	  you know what you are doing. It has to start before the net stack.

config IEEE802154_AT86RF233_RX_STACK_SIZE
	int "Driver's internal RX thread stack size"
	default 800
	help
	  This option sets the driver's stack size for its internal RX thread.
	  The default value should be sufficient, but in case it proves to be
	  a too little one, this option makes it easy to play with the size.

endif
```

## drivers/rtc/Kconfig.sam0_rtc
```kconfig
# Kconfig - SAM0 RTC configuration options
#
# Copyright (c) 2019 ML!PA Consulting GmbH
#
# SPDX-License-Identifier: Apache-2.0
#

config RTC_SAM0
	bool "Atmel SAM0 RTC Driver"
	depends on SOC_FAMILY_SAM0
	help
	  Build RTC driver for SAM0 SoCs.
```

## dts/bindings/flash_controller/atmel,sam0-nvmctrl.yaml
```yaml
title: Atmel SAM0 Non-Volatile Memory Controller

description: >
    This binding gives a base representation of the Atmel SAM0 NVMC

compatible: "atmel,sam0-nvmctrl"

include: flash-controller.yaml

properties:
    compatible:
      constraint: "atmel,sam0-nvmctrl"

    lock-regions:
      type: int
      category: required
      generation: define
      description: Number of lock regions
```

## dts/bindings/ieee802154/atmel,at86rf233.yaml
```yaml
#
# Copyright (c) 2019 ML!PA Consulting GmbH
#
# SPDX-License-Identifier: Apache-2.0
#
---
title: Atmel AT86RF233 802.15.4 Wireless Transceiver
version: 0.1

description: >
    This is a representation of the Atmel AT86RF233 wireless transceiver.

inherits:
    !include spi-device.yaml

properties:
    compatible:
      constraint: "atmel,at86rf233"

    irq-gpios:
      type: compound
      category: required
      generation: define, use-prop-name

    slp_tr-gpios:
      type: compound
      category: required
      generation: define, use-prop-name

    reset-gpios:
      type: compound
      category: required
      generation: define, use-prop-name
...
```

## dts/bindings/rng/atmel,sam0-trng.yaml
```yaml
#
# Copyright (c) 2019 ML!PA Consulting GmbH
#
# SPDX-License-Identifier: Apache-2.0
#
---
title: Atmel SAM0 TRNG (True Random Number Generator)

description: >
    This binding gives a base representation of the Atmel SAM0 RNG

compatible: "atmel,sam0-trng"

properties:
    reg:
      type: int
      description: mmio register space
      required: true

    interrupts:
      type: compound
      required: true
      description: required interrupts

    label:
      type: string
      required: true
      description: Human readable string describing the device (used by Zephyr for API name)

...
```

## soc/arm/atmel_sam0/Kconfig
```kconfig
# Kconfig - Atmel SAM0 MCU family configuration options
#
# Copyright (c) 2017 Google LLC.
# SPDX-License-Identifier: Apache-2.0

config SOC_FAMILY_SAM0
	bool
	select HAS_SEGGER_RTT
	select SYS_POWER_LOW_POWER_STATES_SUPPORTED
	select SYS_POWER_STATE_CPU_LPS_1_SUPPORTED
	select SYS_POWER_STATE_CPU_LPS_2_SUPPORTED
	select SYS_POWER_STATE_CPU_LPS_3_SUPPORTED
	select SYS_POWER_DEEP_SLEEP_STATES_SUPPORTED
	select SYS_POWER_STATE_DEEP_SLEEP_1_SUPPORTED

if SOC_FAMILY_SAM0

config SOC_FAMILY
	string
	default "atmel_sam0"

source soc/arm/atmel_sam0/common/Kconfig.samd2x
source "soc/arm/atmel_sam0/*/Kconfig.soc"
endif
```

## soc/arm/atmel_sam0/common/Kconfig.defconfig.series
```kconfig
# Kconfig.defconfig.series - Atmel SAM0 all MCU lines
#
# Copyright (c) 2019 Benjamin Valentin
#
# SPDX-License-Identifier: Apache-2.0
#

if SOC_FAMILY_SAM0

if SERIAL
config UART_SAM0
	default y
endif

if GPIO
config GPIO_SAM0
	default y
endif

if WATCHDOG
config WDT_SAM0
	default y
endif

if SPI
config SPI_SAM0
	default y
endif

if PINMUX
config PINMUX_SAM0
	default y
endif

if RTC
config RTC_SAM0
	default y
endif

endif # SOC_FAMILY_SAM0
```
