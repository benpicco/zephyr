## boards/microchip/pic32c/pic32wm_bz6204_curiosity/Kconfig.defconfig
```kconfig
# Copyright (c) 2025 Microchip Technology Inc.
# SPDX-License-Identifier: Apache-2.0

if BOARD_PIC32WM_BZ6204_CURIOSITY

config NET_L2_ETHERNET
	default y if NETWORKING

endif # BOARD_PIC32WM_BZ6204_CURIOSITY
```

## drivers/ieee802154/Kconfig.at86rf215
```kconfig
# Microchip (Atmel) AT86RF215 configuration options

# Copyright (c) 2026 ML!PA Consulting GmbH
# SPDX-License-Identifier: Apache-2.0

menuconfig IEEE802154_AT86RF215
	bool "Microchip AT86RF215 driver support"
	default y
	depends on DT_HAS_ATMEL_AT86RF215_ENABLED
	select SPI
	select GPIO

if IEEE802154_AT86RF215

config IEEE802154_AT86RF215_RX_STACK_SIZE
	int "Driver's internal IRQ thread stack size"
	default 1024
	help
	  This option sets the stack size of the driver's internal thread that
	  services the transceiver interrupts of both radios.

config IEEE802154_AT86RF215_RX_THREAD_PRIO
	int "Driver's internal IRQ thread priority"
	default 2
	help
	  Cooperative priority of the driver's internal thread that services
	  the transceiver interrupts.

config IEEE802154_AT86RF215_TX_RETRIES
	int "Number of frame retransmissions"
	default 3
	range 0 7
	help
	  Number of times a frame is retransmitted if no ACK frame was
	  received (macMaxFrameRetries).

config IEEE802154_AT86RF215_CCA_THRESHOLD
	int "CCA energy detection threshold [dBm]"
	default -75
	range -127 4
	help
	  The channel is considered busy if the energy measured during clear
	  channel assessment exceeds this threshold (legacy O-QPSK PHY). IEEE 802.15.4 requires
	  the threshold to be at most 10 dB above the receiver sensitivity
	  of the PHY (-85 dBm for O-QPSK), which is also the reset value of
	  the transceiver.

config IEEE802154_AT86RF215_SUN_CCA_THRESHOLD
	int "CCA energy detection threshold for MR-O-QPSK [dBm]"
	default -90
	range -127 4
	help
	  CCA energy detection threshold of radios that use the SUN O-QPSK
	  (MR-O-QPSK) PHY. IEEE 802.15.4 requires the threshold to be at
	  most -90 dBm for this PHY.

config IEEE802154_AT86RF215_INIT_PRIO
	int "AT86RF215 initialization priority"
	default 80
	help
	  Set the initialization priority number. The driver requires SPI and
	  GPIO to be ready first and has to start before the net stack.

endif
```

## drivers/ieee802154/Kconfig.mrf24j40
```kconfig
# Microchip MRF24J40 configuration options
# SPDX-License-Identifier: Apache-2.0

menuconfig IEEE802154_MRF24J40
	bool "Microchip MRF24J40 Driver support"
	default y
	depends on DT_HAS_MICROCHIP_MRF24J40_ENABLED
	select SPI
	select GPIO

if IEEE802154_MRF24J40

config IEEE802154_MRF24J40_RX_STACK_SIZE
	int "Driver's internal RX thread stack size"
	default 1024
	help
	  Sets the stack size for the driver's interrupt-processing thread.

config IEEE802154_MRF24J40_INIT_PRIO
	int "MRF24J40 initialization priority"
	default 80
	help
	  The driver must initialize after its SPI and GPIO devices.

endif
```

## dts/bindings/ethernet/microchip,gmac-g1-eth.yaml
```yaml
# Copyright (c) 2026 Microchip Technology Inc.
# SPDX-License-Identifier: Apache-2.0

title: Microchip G1 GMAC Ethernet Controller

description: |
  Microchip GMAC Ethernet

  Group G1 Ethernet device supports following hardware peripherals:
    - module name="GMAC" id="U2005" version="1.0.0"

  The MDIO bus is provided by this device and is used to communicate
  with Ethernet PHY.

compatible: "microchip,gmac-g1-eth"

include:
  - name: ethernet-controller.yaml
  - name: pinctrl-device.yaml

properties:
  phy-handle:
    required: true

  num-queues:
    type: int
    required: true
    description: |
      Number of hardware TX and RX queues.
      Range: 1 - 8

  phy-connection-type:
    default: "rmii"

  clocks:
    type: phandle-array

  microchip,gmac-has-wrapper:
    type: boolean
    description: |
      Some GMAC instances (e.g. PIC32CZ CA80/CA90) place the Cadence GEM
      core registers behind an additional wrapper register block (clock
      request/enable, AXI master port configuration, write-protect
      control) starting at offset 0x0, with the GEM core itself appearing
      at a fixed offset within the peripheral's register space. Set this
      property when such a wrapper is present so the driver performs the
      extra wrapper enable/clock-request sequence before touching the
      core GMAC registers.

examples:
  - |
    &gmac {
      compatible = "microchip,gmac-g1-eth";
      interrupts = <84 0>;
      interrupt-names = "gmac";
      num-queues = <1>;
    };
```

## dts/bindings/ieee802154/atmel,at86rf215.yaml
```yaml
# Copyright (c) 2026 ML!PA Consulting GmbH
# SPDX-License-Identifier: Apache-2.0

description: |
  Microchip (Atmel) AT86RF215 dual-band IEEE 802.15.4 transceiver

  The AT86RF215 contains two independent radios that share a single SPI
  interface, reset line and interrupt line:

    - radio@0: sub-GHz radio (RF09, 389.5-510 MHz and 779-1020 MHz)
    - radio@1: 2.4 GHz radio (RF24, 2400-2483.5 MHz)

  Each enabled child node is exposed as an individual IEEE 802.15.4
  network interface.

  Example:

    &spi0 {
        at86rf215@0 {
            compatible = "atmel,at86rf215";
            reg = <0>;
            spi-max-frequency = <DT_FREQ_M(8)>;
            irq-gpios = <&gpio0 1 GPIO_ACTIVE_HIGH>;
            reset-gpios = <&gpio0 2 GPIO_ACTIVE_LOW>;
            #address-cells = <1>;
            #size-cells = <0>;

            radio@0 {
                reg = <0>;
            };

            radio@1 {
                reg = <1>;
                phy = "mr-oqpsk";
                sun-band = <2450>;
            };
        };
    };

compatible: "atmel,at86rf215"

include: spi-device.yaml

properties:
  irq-gpios:
    type: phandle-array
    required: true
    description: |
      Interrupt line (IRQ pin). The transceiver drives it active high
      by default.

  reset-gpios:
    type: phandle-array
    required: true
    description: Reset line (RSTN pin), active low.

  xtal-trim:
    type: int
    description: |
      Crystal oscillator load capacitance trim value (RF_XOC.TRIM, 0-15).
      Each step adds 0.3 pF to both crystal pins. If not set, the reset
      value of the transceiver is kept.

  "#address-cells":
    type: int
    const: 1

  "#size-cells":
    type: int
    const: 0

child-binding:
  description: AT86RF215 radio (sub-GHz or 2.4 GHz)

  properties:
    reg:
      type: array
      required: true
      description: |
        Radio index: 0 selects the sub-GHz radio (RF09 / BBC0),
        1 selects the 2.4 GHz radio (RF24 / BBC1).

    local-mac-address:
      type: uint8-array
      description: |
        Extended (EUI-64) address of the interface. If not set, a random
        address is used.

    phy:
      type: string
      default: "oqpsk"
      enum:
        - "oqpsk"
        - "mr-oqpsk"
      description: |
        PHY of the radio.
          - oqpsk: legacy O-QPSK PHY (250 kb/s), channel page 0
            (2.4 GHz, channels 11-26) or channel page 2 (915 MHz band,
            channels 1-10).
          - mr-oqpsk: SUN O-QPSK PHY (IEEE 802.15.4g), channel page 9.
            Requires sun-band.

    sun-band:
      type: int
      enum:
        - 470
        - 780
        - 866
        - 868
        - 870
        - 915
        - 917
        - 2450
      description: |
        Band designation (MHz) of the SUN O-QPSK PHY. The channel plan
        follows IEEE 802.15.4-2024 table 11-14, channels are numbered
        from 0:
          - 470: 470.2 MHz + n * 200 kHz, 199 channels
          - 780: 779.2 MHz + n * 200 kHz, 39 channels (100 kchip/s)
                 780 MHz + n * 2 MHz, 4 channels (1000 kchip/s)
          - 866: 865.1 MHz + n * 200 kHz, 15 channels
          - 868: 868.3, 868.95 and 869.525 MHz (table 11-16)
          - 870: 870.2 MHz + n * 200 kHz, 29 channels
          - 915: 902.2 MHz + n * 200 kHz, 129 channels (100 kchip/s)
                 904 MHz + n * 2 MHz, 12 channels (1000 kchip/s)
          - 917: 917.1 MHz + n * 200 kHz, 32 channels (100 kchip/s)
                 918.1 MHz + n * 2 MHz, 3 channels (1000 kchip/s)
          - 2450: 2405 MHz + n * 5 MHz, 16 channels
        The 2450 MHz band requires radio@1, all other bands radio@0.

    chip-rate:
      type: int
      enum:
        - 100
        - 200
        - 1000
        - 2000
      description: |
        Chip rate (kchip/s) of the SUN O-QPSK PHY. The standard defines
        100 and 1000 kchip/s for the 780, 915 and 917 MHz bands,
        2000 kchip/s for the 2450 MHz band and 100 kchip/s for all other
        bands. 200 kchip/s is proprietary.
        The 2450 MHz band only supports 2000 kchip/s. In the sub-GHz bands
        any chip rate can be used for compatibility with non-standard
        devices, the channel plan of the band's lowest standard chip rate
        then applies. Note that this may violate regional regulations.
        Defaults to 2000 kchip/s in the 2450 MHz band and 100 kchip/s
        otherwise.

    rate-mode:
      type: int
      default: 0
      enum:
        - 0
        - 1
        - 2
        - 3
      description: |
        Rate mode of transmitted frames of the SUN O-QPSK PHY. The data
        rate is 6.25, 12.5, 25 or 50 kb/s at 100 kchip/s and 31.25, 125,
        250 or 500 kb/s at 1000 and 2000 kchip/s. Frames of any rate
        mode are received, ACK frames are sent with the rate mode of the
        acknowledged frame.
```

## dts/bindings/ieee802154/microchip,mrf24j40.yaml
```yaml
# SPDX-License-Identifier: Apache-2.0

description: Microchip MRF24J40 2.4 GHz IEEE 802.15.4 transceiver

compatible: "microchip,mrf24j40"

include: spi-device.yaml

properties:
  irq-gpios:
    type: phandle-array
    required: true
    description: |
      Interrupt output (INT) from the radio. The driver configures the
      radio for a rising-edge interrupt, so this must be GPIO_ACTIVE_HIGH.

  reset-gpios:
    type: phandle-array
    required: true
    description: |
      Hardware reset input (RESET). The pin is active-low, so this should
      be GPIO_ACTIVE_LOW.

  local-mac-address:
    type: uint8-array
    min-len: 8
    max-len: 8
    description: IEEE 802.15.4 extended address
```

## soc/microchip/pic32c/pic32cx_bz/bz2x/Kconfig.soc
```kconfig
# Copyright (c) 2025 Microchip Technology Inc.
# SPDX-License-Identifier: Apache-2.0

config SOC_FAMILY_MICROCHIP_PIC32CX_BZ2
	bool

config SOC_FAMILY
	default "microchip_pic32cx_bz2" if SOC_FAMILY_MICROCHIP_PIC32CX_BZ2

config SOC_SERIES_REVISION_N
	bool
	depends on SOC_FAMILY_MICROCHIP_PIC32CX_BZ2

config SOC_SERIES_REVISION
	string
	default "n" if SOC_SERIES_REVISION_N
	default ""
	depends on SOC_FAMILY_MICROCHIP_PIC32CX_BZ2

config SOC_SERIES_PIC32CX_BZ24
	bool
	select SOC_FAMILY_MICROCHIP_PIC32CX_BZ2
	help
	  Enable support for Microchip PIC32CX_BZ2 Cortex-M4F microcontrollers.

config SOC_SERIES_PIC32CX_BZ25
	bool
	select SOC_FAMILY_MICROCHIP_PIC32CX_BZ2
	help
	  Enable support for Microchip PIC32CX_BZ2 Cortex-M4F microcontrollers.

config SOC_SERIES
	default "bz24" if SOC_SERIES_PIC32CX_BZ24
	default "bz25" if SOC_SERIES_PIC32CX_BZ25

config SOC_PIC32CX1012BZ24032
	bool
	select SOC_SERIES_PIC32CX_BZ24

config SOC_PIC32CX1012BZ25048
	bool
	select SOC_SERIES_PIC32CX_BZ25

config SOC
	default "pic32cx1012bz24032" if SOC_PIC32CX1012BZ24032
	default "pic32cx1012bz25048" if SOC_PIC32CX1012BZ25048

config HPA_SUPPORTED
	bool
```

## soc/microchip/pic32c/pic32cx_bz/bz3x/Kconfig.soc
```kconfig
# Copyright (c) 2025 Microchip Technology Inc.
# SPDX-License-Identifier: Apache-2.0

config SOC_FAMILY_MICROCHIP_PIC32CX_BZ3
	bool

config SOC_FAMILY
	default "microchip_pic32cx_bz3" if SOC_FAMILY_MICROCHIP_PIC32CX_BZ3

config SOC_SERIES_REVISION_N
	bool
	depends on SOC_FAMILY_MICROCHIP_PIC32CX_BZ3

config SOC_SERIES_REVISION
	string
	default "n" if SOC_SERIES_REVISION_N
	default ""
	depends on SOC_FAMILY_MICROCHIP_PIC32CX_BZ3

config SOC_SERIES_PIC32CX_BZ3
	bool
	select SOC_FAMILY_MICROCHIP_PIC32CX_BZ3
	help
	  Enable support for Microchip PIC32CX_BZ3 Cortex-M4F microcontrollers.

config SOC_SERIES_PIC32CX_BZ36
	bool
	select SOC_FAMILY_MICROCHIP_PIC32CX_BZ3
	help
	  Enable support for Microchip PIC32CX_BZ3 Cortex-M4F microcontrollers.

config SOC_SERIES
	default "bz3" if SOC_SERIES_PIC32CX_BZ3
	default "bz36" if SOC_SERIES_PIC32CX_BZ36

config SOC_PIC32CX5109BZ31048
	bool
	select SOC_SERIES_PIC32CX_BZ3

config SOC_PIC32CX5109BZ31032
	bool
	select SOC_SERIES_PIC32CX_BZ3

config SOC_PIC32CX5109BZ36048
	bool
	select SOC_SERIES_PIC32CX_BZ36

config SOC_PIC32CX5109BZ36032
	bool
	select SOC_SERIES_PIC32CX_BZ36

config SOC
	default "pic32cx5109bz31048" if SOC_PIC32CX5109BZ31048
	default "pic32cx5109bz31032" if SOC_PIC32CX5109BZ31032
	default "pic32cx5109bz36048" if SOC_PIC32CX5109BZ36048
	default "pic32cx5109bz36032" if SOC_PIC32CX5109BZ36032
```
